/**
  * This sketch demonstrates how to use an FFT to analyze
  * the audio being generated by an AudioPlayer.
  * <p>
  * FFT stands for Fast Fourier Transform, which is a
  * method of analyzing audio that allows you to visualize
  * the frequency content of a signal. You've seen
  * visualizations like this before in music players
  * and car stereos.
  * <p>
  * For more information about Minim and additional features,
  * visit http://code.compartmental.net/minim/
  */

import ddf.minim.analysis.*;
import ddf.minim.*;
import processing.serial.*;

Minim       minim;
FFT         fft;
AudioInput in;
Serial myPort;  // Create object from Serial class
BeatDetect beat;


void setup()
{
  size(1024, 600, P3D);
  int bufferSize = 1024;
  float sampleRate = 48000;
  minim = new Minim(this);
  in = minim.getLineIn(Minim.STEREO, bufferSize, sampleRate);
  beat = new BeatDetect();
  // create an FFT object that has a time-domain buffer
  // the same size as jingle's sample buffer
  // note that this needs to be a power of two
  // and that it means the size of the spectrum will be half as large.
  fft = new FFT(in.bufferSize(), in.sampleRate());
  fft.window(FFT.GAUSS);
  String portName = Serial.list()[0];
  myPort = new Serial(this, portName, 115200);

  color inside = #FF00FF;

  translate(360, 80);
  fill(inside);
}
  int avg = 127;
  float power = 0;
  float totalPower = 0;

void draw()
{


  background(0);
  //noStroke();
  stroke(0,255,255);
int out = 0;
byte out0 = 0;
byte out1 = 0;
byte out2 = 0;
byte out3 = 0;
  int intensity;
  float signal;
  int filter = 5;
  int freq;

  // perform a forward FFT on the samples in jingle's mix buffer,
  // which contains the mix of both the left and right channels of the file
  fft.forward(in.mix);
  beat.detect(in.mix);
  power = 0;
  for(int i = 0; i < fft.specSize()*2; i++)
  {
    // draw the line for frequency band i, scaling it up a bit so we can see it
    line( i, height, i, height - fft.getBand(i/8)*8 );
    power = power + fft.getBand(i/8)*8;
  }

  println(power);
  totalPower = power/(fft.specSize()*4);
  if(totalPower < 1) totalPower = 1;
  println(totalPower);


  signal = (fft.getBand(1) + fft.getBand(2))*2;
  println(signal);

  signal = signal+totalPower;
  signal = signal;
  println(signal);


  if(signal <0) signal = 0;
  avg = (filter*avg+(int)signal)/(filter+1);
  intensity = (avg-50)*2;


  if(intensity < 0) intensity = 0;
  if (intensity > 255) intensity = 255;
  println(intensity);
  println(" ");
  rect( 0, 0, (float)intensity/255*width, 100 );

  freq = fft.avgSize();
  println(freq);
  println(" ");


  out = (intensity & 0x0000FF);


  myPort.write(out);

}
